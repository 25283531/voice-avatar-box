## firmware/sdkconfig.defaults
```kconfig
# 目标：立创·实战派 ESP32-S3（N16R8）
CONFIG_IDF_TARGET="esp32s3"

# 16MB Flash / 8MB Octal PSRAM
CONFIG_ESPTOOLPY_FLASHSIZE_16MB=y
CONFIG_SPIRAM=y
CONFIG_SPIRAM_MODE_OCT=y
CONFIG_SPIRAM_SPEED_80M=y
CONFIG_SPIRAM_FETCH_INSTRUCTIONS=y
CONFIG_SPIRAM_RODATA=y

# 控制台走原生 USB Serial/JTAG（与板上出厂固件一致，方便观察日志）
CONFIG_ESP_CONSOLE_USB_SERIAL_JTAG=y

# 编译优化与看门狗
CONFIG_COMPILER_OPTIMIZATION_SIZE=y
CONFIG_ESP_TASK_WDT_TIMEOUT_S=10
CONFIG_FREERTOS_HZ=100
```

## firmware/xiaozhi/sdkconfig.defaults.esp32s3
```kconfig
CONFIG_ESPTOOLPY_FLASHSIZE_16MB=y
CONFIG_ESPTOOLPY_FLASHMODE_QIO=y

CONFIG_ESP_DEFAULT_CPU_FREQ_MHZ_240=y

CONFIG_SPIRAM=y
CONFIG_SPIRAM_MODE_OCT=y
CONFIG_SPIRAM_SPEED_80M=y
CONFIG_SPIRAM_MALLOC_ALWAYSINTERNAL=512
CONFIG_SPIRAM_MALLOC_RESERVE_INTERNAL=65536
CONFIG_SPIRAM_MEMTEST=n
CONFIG_MBEDTLS_EXTERNAL_MEM_ALLOC=y

CONFIG_ESP_WIFI_STATIC_RX_BUFFER_NUM=3
CONFIG_ESP_WIFI_DYNAMIC_RX_BUFFER_NUM=6
CONFIG_ESP_WIFI_RX_BA_WIN=3
CONFIG_LWIP_TCPIP_RECVMBOX_SIZE=16
CONFIG_MBEDTLS_DYNAMIC_FREE_CONFIG_DATA=y

CONFIG_ESP32S3_INSTRUCTION_CACHE_32KB=y
CONFIG_ESP32S3_DATA_CACHE_LINE_64B=y

# WakeNet9 唤醒模型：上游自带「你好小智」（wn9_nihaoxiaozhi_tts）。
# 2026-10-20 回归上游小智后恢复此行；此前为自研「你好小安」曾删除它。
# set-target 时本文件与 sdkconfig.defaults **叠加**读取，两者不要配不同符号的
# wn9 模型（会同时打进 srmodels.bin，唤醒词由加载顺序决定）。
CONFIG_SR_WN_WN9_NIHAOXIAOZHI_TTS=y

CONFIG_ESP_SYSTEM_EVENT_TASK_STACK_SIZE=4096

# LVGL Graphics
CONFIG_LV_USE_SNAPSHOT=y
```
